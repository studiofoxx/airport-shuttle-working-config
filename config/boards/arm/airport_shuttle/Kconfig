## config/boards/arm/airport_shuttle/Kconfig
```kconfig
# SPDX-License-Identifier: MIT

config BOARD_ENABLE_DCDC
	bool "Enable DCDC mode"
	select SOC_DCDC_NRF52X
	default y
	depends on BOARD_AIRPORT_SHUTTLE
	CONFIG_ZMK_BLE_EXPERIMENTAL_FEATURES=y
```

## config/boards/arm/airport_shuttle/Kconfig.defconfig
```kconfig
# Copyright (c) 2020 Taylor Glaeser
# SPDX-License-Identifier: MIT

if BOARD_AIRPORT_SHUTTLE || BOARD_RAYTAC_MDBT50Q_RX

config BOARD
	default "airport_shuttle"

config ZMK_KEYBOARD_NAME
	default "Airport Shuttle"
if USB

config USB_NRFX
	default y

config USB_DEVICE_STACK
	default y

endif # USB

config BT_CTLR
	default BT

config ZMK_BLE
	default y

config ZMK_USB
	default y

endif

if SHIELD_AIRPORT_SHUTTLE_DONGLE

config BT_MAX_PAIRED
    default 7

config BT_MAX_CONN
    default 7

config ZMK_SPLIT_BLE_PREF_INT
    default 6

config ZMK_SPLIT_BLE_PREF_LATENCY
    default 399

config ZMK_SPLIT_BLE_PREF_TIMEOUT
    default 900

endif
```
